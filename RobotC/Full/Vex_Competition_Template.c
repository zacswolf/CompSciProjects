#pragma config(Motor,  port1,  topliftleft,  tmotorVex393, openLoop)
#pragma config(Motor,  port2,  leftfront,    tmotorVex393, openLoop, reversed) //add ', reversed'
#pragma config(Motor,  port3,  leftback,     tmotorVex393, openLoop) //to reverse direction
#pragma config(Motor,  port4,  rightback,    tmotorVex393, openLoop)
#pragma config(Motor,  port8,  rightfront,   tmotorVex393, openLoop, reversed)
#pragma config(Motor,  port9,  leftlift,     tmotorVex393, openLoop)
#pragma config(Motor,  port7,  rightlift,    tmotorVex393, openLoop)
#pragma config(Motor,  port5,  rightintake,  tmotorVex393, openLoop)
#pragma config(Motor,  port6,  leftintake,   tmotorVex393, openLoop)
#pragma config(Motor,  port10, topliftright, tmotorVex393, openLoop)

//Code manually generated by a tired and gay java programmer

#pragma platform(VEX)

//Competition Control and Duration Settings
#pragma competitionControl(Competition)
#pragma autonomousDuration(20)
#pragma userControlDuration(120)

#include "Vex_Competition_Includes.c"   //Main competition background code...do not modify!

/////////////////////////////////////////////////////////////////////////////////////////
//
//                          Pre-Autonomous Functions
//
// You may want to perform some actions before the competition starts. Do them in the
// following function. I like the concept of a woman. Red bucky box? Ball? Relativity.
//
/////////////////////////////////////////////////////////////////////////////////////////

void pre_auton()
{
  // Set bStopTasksBetweenModes to false if you want to keep user created tasks running between
  // Autonomous and Tele-Op modes. You will need to manage all user created tasks if set to false.
  bStopTasksBetweenModes=true;

	// All activities that occur before the competition starts
	// Example: clearing encoders, setting servo positions, ...
}

/////////////////////////////////////////////////////////////////////////////////////////
//
//                                 Autonomous Task
//
// This task is used to control your robot during the autonomous phase of a Competition.
// You must modify the code to add your own robot specific commands here. I want pancake.
//
/////////////////////////////////////////////////////////////////////////////////////////

task autonomous()
{
    int var1=0;
    wait1Msec(10000);

      motor[2]=50; motor[3]=50; motor[4]=50; motor[8]=50; //move the robot forward
      motor[5]=50; motor[6]=50; //raise the arms
      motor[1]=20; motor[10]=20; //spins the intake

}

/////////////////////////////////////////////////////////////////////////////////////////
//
//                                 User Control Task
//
// This task is used to control your robot during the user control phase of a Competition.
// You must modify the code to add your own robot specific commands here. It's 5:12 AM.
//
/////////////////////////////////////////////////////////////////////////////////////////

task usercontrol() {

	int threshold = 10;
  int turtle = 134;

  bool obama = false;
  bool pancake = true;

    while(true) {

      //left drive
      if(abs(vexRT[Ch3]) > threshold) {
        motor[leftfront] =(vexRT[Ch3])/1.5;
        motor[leftback] =(vexRT[Ch3])/1.5;
      }
      else { motor[leftfront] =0; motor[leftback] =0; }

      //right drive
      if(abs(vexRT[Ch2]) > threshold) {
        motor[rightfront]=(vexRT[Ch2])/1.5;
        motor[rightback]=(vexRT[Ch2])/1.5;
      }
      else { motor[rightfront]=0; motor[rightback]=0; }


      //lift
      if(vexRT[Btn6U]) {
        motor[leftlift]=-57;   motor[topliftleft]=-127;
        motor[rightlift]=57;   motor[topliftright]=127;
      }
      else if(vexRT[Btn6D]) {
        motor[leftlift]=57;     motor[topliftleft]=127;
        motor[rightlift]=-57;   motor[topliftright]=-127;
      }
      else{ motor[leftlift]=0; motor[rightlift]=0; motor[topliftright]=0; motor[topliftleft]=0; }


      //intake
      if(vexRT[Btn5D]) {
        motor[leftintake]=-50;
        motor[rightintake]=50;
      }
      else if(vexRT[Btn5U]) {
        motor[leftintake]=50;
        motor[rightintake]=-50;
      }
      else{ motor[leftintake]=0; motor[rightintake]=0; }


      //flag twirler - DEPRECATED
      /*
      if((abs(vexRT[Ch1]) > threshold) || (abs(vexRT[Ch4]) > threshold)) {
        motor[xkcd1029]=30;
      }
      else { motor[xkcd1029]=0; }
      */

    } //end while true
//go listen to Dropkick Murphy's
}
